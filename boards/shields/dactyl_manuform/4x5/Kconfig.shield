## boards/shields/dactyl_manuform/4x5/Kconfig.shield
```kconfig
config SHIELD_DM_4X5_LEFT
    def_bool $(shields_list_contains,dm_4x5_left)
#     select SHIELD_DM_4X5_LEFT

config SHIELD_DM_4X5_RIGHT
    def_bool $(shields_list_contains,dm_4x5_right)
#     select SHIELD_DM_4X5_RIGHT
```

## config/boards/shields/dm_4x5/Kconfig.defconfig
```kconfig
if SHIELD_DM_4X5_LEFT

config ZMK_KEYBOARD_NAME
    default "dm_4x5"

config ZMK_SPLIT_ROLE_CENTRAL
    default y

endif

if SHIELD_DM_4X5_LEFT || SHIELD_DM_4X5_RIGHT

config ZMK_SPLIT
    default y

endif
```
